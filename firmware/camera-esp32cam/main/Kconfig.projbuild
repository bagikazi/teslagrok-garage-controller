## firmware/camera-esp32cam/main/Kconfig.projbuild
```kconfig
menu "Garage camera"
config GARAGE_CAMERA_BOARD_PROFILE
    string "Camera board profile"
    default "AI_THINKER_ESP32_CAM"
config GARAGE_CAMERA_BOARD_AI_THINKER
    bool "Use validated AI Thinker ESP32-CAM pin map"
    default n
config GARAGE_CAMERA_WIFI_SSID
    string "Wi-Fi SSID"
config GARAGE_CAMERA_WIFI_PASSWORD
    string "Wi-Fi password"
config GARAGE_CAMERA_MQTT_URI
    string "MQTT URI"
config GARAGE_CAMERA_ID
    string "Camera ID"
    default "camera-esp32cam-001"
config GARAGE_CAMERA_GARAGE_ID
    string "Garage ID"
    default "garage-01"
config GARAGE_CAMERA_FIRMWARE_VERSION
    string "Firmware version"
    default "0.2.0"
config GARAGE_CAMERA_UPLOAD_URL
    string "HTTPS upload URL"
config GARAGE_CAMERA_UPLOAD_TOKEN
    string "HTTPS upload token"
config GARAGE_CAMERA_DEVICE_TOKEN
    string "Camera device credential"
    help
        Separate long-lived device credential. Never reuse an admin, database or SSH credential.
config GARAGE_CAMERA_MQTT_USERNAME
    string "MQTT username"
config GARAGE_CAMERA_MQTT_PASSWORD
    string "MQTT password"
config GARAGE_CAMERA_INGEST_SCHEME
    string "Live ingest WebSocket scheme"
    default "ws"
endmenu
```

## firmware/camera-esp32cam/sdkconfig.defaults
```kconfig
CONFIG_IDF_TARGET="esp32"
CONFIG_PARTITION_TABLE_SINGLE_APP_LARGE=y
CONFIG_MBEDTLS_CERTIFICATE_BUNDLE=y
CONFIG_MBEDTLS_CERTIFICATE_BUNDLE_DEFAULT_FULL=y
CONFIG_GARAGE_CAMERA_BOARD_PROFILE="AI_THINKER_ESP32_CAM"
CONFIG_GARAGE_CAMERA_BOARD_AI_THINKER=y
CONFIG_GARAGE_CAMERA_WIFI_SSID=""
CONFIG_GARAGE_CAMERA_WIFI_PASSWORD=""
CONFIG_GARAGE_CAMERA_MQTT_URI="mqtts://garage.example.invalid:8883"
CONFIG_GARAGE_CAMERA_ID="camera-esp32cam-001"
CONFIG_GARAGE_CAMERA_GARAGE_ID="garage-01"
CONFIG_GARAGE_CAMERA_FIRMWARE_VERSION="0.2.0"
CONFIG_GARAGE_CAMERA_UPLOAD_URL="https://garage.example.invalid/api/camera/upload"
CONFIG_GARAGE_CAMERA_UPLOAD_TOKEN=""
CONFIG_GARAGE_CAMERA_DEVICE_TOKEN=""
CONFIG_GARAGE_CAMERA_MQTT_USERNAME=""
CONFIG_GARAGE_CAMERA_MQTT_PASSWORD=""
CONFIG_GARAGE_CAMERA_INGEST_SCHEME="wss"
CONFIG_WS_TRANSPORT=y
```

## firmware/controller-s3/main/Kconfig.projbuild
```kconfig
menu "Garage controller"
config GARAGE_ENABLE_RELAY
    bool "Enable relay output"
    default n
    help
        Keep disabled for diagnostic firmware. Enable only after GPIO and opener safety validation.
config GARAGE_WIFI_SSID
    string "Wi-Fi SSID"
    default ""
config GARAGE_WIFI_PASSWORD
    string "Wi-Fi password"
    default ""
config GARAGE_MQTT_URI
    string "MQTT broker URI"
    default "mqtts://garage.example.invalid:8883"
config GARAGE_DEVICE_ID
    string "Controller device ID"
    default "controller-s3-001"
config GARAGE_MQTT_USERNAME
    string "MQTT username"
    default ""
config GARAGE_MQTT_PASSWORD
    string "MQTT password"
    default ""
config GARAGE_RELAY_PULSE_MS
    int "Relay pulse duration (ms)"
    range 100 2000
    default 300
config GARAGE_RELAY_INTERLOCK_MS
    int "Relay interlock delay (ms)"
    range 50 2000
    default 100
config GARAGE_REOPEN_DELAY_MS
    int "Stop-to-reopen delay (ms)"
    range 100 2000
    default 400
config GARAGE_HCSR04_BASELINE_CM
    int "HC-SR04 empty-doorway distance (cm)"
    range 20 400
    default 150
    help
        Distance the HC-SR04 measures across the empty doorway to the fixed
        target on the opposite side. Shorter readings mean something is in the beam.
config GARAGE_TOF_BASELINE_CM
    int "VL53L0X empty-doorway distance (cm), 0 = presence mode"
    range 0 200
    default 0
    help
        Distance the VL53L0X measures across the empty doorway. 0 selects
        presence mode for doorways wider than the sensor range: no target means
        clear, anything within 150 cm is an obstacle. Calibration picks the
        mode automatically.
config GARAGE_BEAM_TOLERANCE_CM
    int "Allowed deviation from the empty-doorway distance (cm)"
    range 3 100
    default 15
config GARAGE_SENSOR_FAULT_TIMEOUT_MS
    int "Sensor fault timeout (ms)"
    range 100 10000
    default 1500
config GARAGE_PIR_LIGHT_ENABLED
    bool "Enable PIR light automation"
    default y
config GARAGE_PIR_LIGHT_TIMEOUT_SECONDS
    int "PIR light timeout (seconds)"
    range 1 3600
    default 120
config GARAGE_FIRMWARE_VERSION
    string "Firmware version"
    default "0.1.0-diagnostic"
config GARAGE_WIFI_PROBE
    bool "Wi-Fi probe only (spare board without display, sensors or relays)"
    default n
    help
        Only joins Wi-Fi and MQTT and publishes telemetry and Wi-Fi reports.
        Build it with its own GARAGE_DEVICE_ID; the API shows it as the
        spare S3 and never lets it touch the controller's status.
endmenu
```

## firmware/controller-s3/sdkconfig.defaults
```kconfig
CONFIG_IDF_TARGET="esp32s3"
CONFIG_PARTITION_TABLE_SINGLE_APP_LARGE=y
CONFIG_GARAGE_ENABLE_RELAY=n
CONFIG_GARAGE_WIFI_SSID=""
CONFIG_GARAGE_WIFI_PASSWORD=""
CONFIG_GARAGE_MQTT_URI="mqtts://garage.example.invalid:8883"
CONFIG_GARAGE_DEVICE_ID="controller-s3-001"
CONFIG_GARAGE_MQTT_USERNAME=""
CONFIG_GARAGE_MQTT_PASSWORD=""
CONFIG_GARAGE_RELAY_PULSE_MS=300
CONFIG_GARAGE_RELAY_INTERLOCK_MS=100
CONFIG_GARAGE_REOPEN_DELAY_MS=400
CONFIG_GARAGE_HCSR04_OBSTACLE_CM=12
CONFIG_GARAGE_TOF_OBSTACLE_CM=12
CONFIG_GARAGE_HCSR04_WARNING_CM=20
CONFIG_GARAGE_TOF_WARNING_CM=20
CONFIG_GARAGE_SENSOR_FAULT_TIMEOUT_MS=1500
CONFIG_GARAGE_SENSOR_DISAGREEMENT_CM=10
CONFIG_GARAGE_PIR_LIGHT_ENABLED=y
CONFIG_GARAGE_PIR_LIGHT_TIMEOUT_SECONDS=120
CONFIG_GARAGE_FIRMWARE_VERSION="0.1.0-diagnostic"
CONFIG_LV_COLOR_DEPTH=16
CONFIG_LWIP_DHCP_RESTORE_LAST_IP=y
CONFIG_LV_FONT_MONTSERRAT_12=y
CONFIG_LV_FONT_MONTSERRAT_14=y
CONFIG_LV_FONT_MONTSERRAT_16=y
CONFIG_LV_FONT_MONTSERRAT_20=y
```
